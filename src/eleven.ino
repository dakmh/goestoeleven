#include <LEDMatrixDriver.hpp>

// This sketch draw marquee text on your LED matrix using the hardware SPI driver Library by Bartosz Bielawski.
// Example written 16.06.2017 by Marko Oette, www.oette.info

// Define the ChipSelect pin for the led matrix (Dont use the SS or MISO pin of your Arduino!)
// Other pins are arduino specific SPI pins (MOSI=DIN of the LEDMatrix and CLK) see https://www.arduino.cc/en/Reference/SPI
const uint8_t LEDMATRIX_CS_PIN = 9;

// Define LED Matrix dimensions (0-n) - eg: 32x8 = 31x7
const int LEDMATRIX_WIDTH = 32;
const int LEDMATRIX_HEIGHT = 8;
const int LEDMATRIX_SEGMENTS = 4;

// The LEDMatrixDriver class instance
LEDMatrixDriver lmd(LEDMATRIX_SEGMENTS, LEDMATRIX_CS_PIN);
int potPin = 2;    // select the input pin for the potentiometer
int dial = 0;       // variable to store the value coming from the sensor

void setup() {
  // init the display
  lmd.setEnabled(true);
  lmd.setIntensity(1);   // 0 = low, 10 = high
  pinMode(potPin, INPUT);  // declare the ledPin as an OUTPUT
  // Serial.begin(9600);
  // Serial.println("Visual Feedback Commencing...");
}

int x=0, y=0;   // start top left

// This is the font definition. You can use http://gurgleapps.com/tools/matrix to create your own font or sprites.
// If you like the font feel free to use it. I created it myself and donate it to the public domain.
byte font[95][8] = { {0,0,0,0,0,0,0,0}, // SPACE
                     {0x10,0x18,0x18,0x18,0x18,0x00,0x18,0x18}, // EXCL
                     {0x28,0x28,0x08,0x00,0x00,0x00,0x00,0x00}, // QUOT
                     {0x00,0x0a,0x7f,0x14,0x28,0xfe,0x50,0x00}, // #
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                     {0x00,0x7c,0x04,0x08,0x7c,0x20,0x40,0xfe}, // Z
                      // (the font does not contain any lower case letters. you can add your own.)
                  };    // {}, //

// Marquee speed
const int ANIM_DELAY = 18;

// Marquee text
// char text[] = "** LED MATRIX DEMO! ** (1234567890) ++ \"ABCDEFGHIJKLMNOPQRSTUVWXYZ\" ++ <$%/=?'.@,> --";
char text_1[] = "D+E <3   ";
char text_2[] = "D+E <3   &   ";
char text_3[] = "   &   ";
char text_4[] = "   & & &  ";
char text_5[] = "  & & :-*-: & &  ";
char text_6[] = " & WHERE   ";
char text_7[] = " & WHERE MOST ";
char text_8[] = " & WHERE MOST MARRIAGES ";
char text_9[] = " & WHERE MOST MARRIAGES GO TO ";
char text_10[] = " & WHERE MOST MARRIAGES GO TO TEN... ";
char text_11[] = "   &   E+D > 11   &   ";
int len = 0;

void loop()
{
  int dial = analogRead(potPin);
  // Serial.println(dial);

  if (dial < (1023/11)) {
    len = strlen(text_1);
    drawString(text_1, len, x, 0);
  }
  else if (dial > (1023/11) && dial < 2*(1023/11)) {
    len = strlen(text_2);
    drawString(text_2, len, x, 0);
  }
  else if (dial > 2*(1023/11) && dial < 3*(1023/11)) {
    len = strlen(text_3);
    drawString(text_3, len, x, 0);
  }
  else if (dial > 3*(1023/11) && dial < 4*(1023/11)) {
    len = strlen(text_4);
    drawString(text_4, len, x, 0);
  }
  else if (dial > 4*(1023/11) && dial < 5*(1023/11)) {
    len = strlen(text_5);
    drawString(text_5, len, x, 0);
  }
  else if (dial > 5*(1023/11) && dial < 6*(1023/11)) {
    len = strlen(text_6);
    drawString(text_6, len, x, 0);
  }
  else if (dial > 6*(1023/11) && dial < 7*(1023/11)) {
    len = strlen(text_7);
    drawString(text_7, len, x, 0);
  }
  else if (dial > 7*(1023/11) && dial < 8*(1023/11)) {
    len = strlen(text_8);
    drawString(text_8, len, x, 0);
  }
  else if (dial > 8*(1023/11) && dial < 9*(1023/11)) {
    len = strlen(text_9);
    drawString(text_9, len, x, 0);
  }
  else if (dial > 9*(1023/11) && dial < 10.5*(1023/11)) {
    len = strlen(text_10);
    drawString(text_10, len, x, 0);
  }
  else if (dial > 10.5*(1023/11)) {
    len = strlen(text_11);
    drawString(text_11, len, x, 0);
  }

  lmd.display();

  // Wait to let the human read the display
  delay(ANIM_DELAY);

  // Advance to next coordinate
  if( --x < len * -8 )
    x = LEDMATRIX_WIDTH;
}


/**
 * This function draws a string of the given length to the given position.
 */
void drawString(char* text, int len, int x, int y )
{
  for( int idx = 0; idx < len; idx ++ )
  {
    int c = text[idx] - 32;

    // stop if char is outside visible area
    if( x + idx * 8  > LEDMATRIX_WIDTH )
      return;

    // only draw if char is visible
    if( 8 + x + idx * 8 > 0 )
      drawSprite( font[c], x + idx * 8, y, 8, 8 );
  }
}

/**
 * This draws a sprite to the given position using the width and height supplied (usually 8x8)
 */
void drawSprite( byte* sprite, int x, int y, int width, int height )
{
  // The mask is used to get the column bit from the sprite row
  byte mask = B10000000;

  for( int iy = 0; iy < height; iy++ )
  {
    for( int ix = 0; ix < width; ix++ )
    {
      lmd.setPixel(x + ix, y + iy, (bool)(sprite[iy] & mask ));

      // shift the mask by one pixel to the right
      mask = mask >> 1;
    }

    // reset column mask
    mask = B10000000;
  }
}
